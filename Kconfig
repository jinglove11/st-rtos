## configs/rp2350_defconfig
```kconfig
#
# My-RTOS Configuration
# Default configuration for RP2350 (Pico 2)
#

PROJECT_NAME="my-rtos"
PROJECT_VERSION="1.0.0"

# Board selection
CONFIG_BOARD_RP2350=y
BOARD_NAME="rp2350"

# Kernel
KERNEL_TICK_RATE=1000
KERNEL_MAX_TASKS=16
KERNEL_MAX_PRIORITIES=32
KERNEL_TASK_STACK_SIZE=1024
KERNEL_IDLE_STACK_SIZE=256
KERNEL_TIME_SLICE=5
KERNEL_WATCHDOG=n
KERNEL_IDLE_SLEEP=y

# Memory
MEM_DYNAMIC=y
MEM_HEAP_SIZE=4096
MEM_POOL_COUNT=4

# IPC
IPC_SEMAPHORE=y
IPC_SEMAPHORE_MAX=8
IPC_MUTEX=y
IPC_MUTEX_MAX=8
IPC_MQUEUE=y
IPC_MQUEUE_MAX=4
IPC_EVENT=y
IPC_EVENT_MAX=4

# Debug
DEBUG_ENABLE=y
DEBUG_LEVEL=2
DEBUG_STACK_CHECK=y
ASSERT_ENABLE=y

# Test
TEST_ENABLE=y
TEST_MODULE_SCHEDULER=y
TEST_MODULE_EXAMPLE=n
```

## configs/stm32f767_defconfig
```kconfig
#
# My-RTOS Configuration
# Default configuration for STM32F767
#

PROJECT_NAME="my-rtos"
PROJECT_VERSION="1.0.0"

# Board selection
CONFIG_BOARD_STM32F767=y
BOARD_NAME="stm32f767"
BOARD_DISPLAY_NAME="Nucleo-F767ZI"

# Kernel
KERN_NAME="My-RTOS"
KERN_VERSION_MAJOR=1
KERN_VERSION_MINOR=0
KERN_VERSION_PATCH=0
KERN_TASK_NAME_LEN=16
KERNEL_TICK_RATE=1000
KERNEL_MAX_TASKS=16
KERNEL_MAX_PRIORITIES=32
KERNEL_TASK_STACK_SIZE=1024
KERNEL_IDLE_STACK_SIZE=256
KERNEL_IDLE_PRIORITY=31
KERN_DEFAULT_TIME_SLICE=5
# KERNEL_WATCHDOG is not set
# KERNEL_WATCHDOG_TIMEOUT=1000
KERN_TASK_STATS=y
TRACE_ENABLE=y
TRACE_BUFFER_SIZE=256
KERNEL_IDLE_SLEEP=y

# Memory
MEM_DYNAMIC=y
MEM_HEAP_SIZE=4096
MEM_POOL_COUNT=4

# IPC
IPC_SEMAPHORE=y
IPC_SEMAPHORE_MAX=8
IPC_MUTEX=y
IPC_MUTEX_MAX=8
IPC_MQUEUE=y
IPC_MQUEUE_MAX=4
IPC_EVENT=y
IPC_EVENT_MAX=4

# Debug
DEBUG_ENABLE=y
DEBUG_LEVEL=2
DEBUG_STACK_CHECK=y
ASSERT_ENABLE=y

# Test
TEST_ENABLE=y
TEST_MODULE_SCHEDULER=y
TEST_MODULE_EXAMPLE=n
TEST_MODULE_FAULT=y
TEST_MODULE_CAP=y
TEST_MODULE_VFS=y
TEST_MODULE_IPC_UPGRADE=y
TEST_MODULE_STATS=y
# TEST_MODULE_WATCHDOG is not set
```
